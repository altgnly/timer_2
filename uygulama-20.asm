	__CONFIG H'3F31'
	LIST P=16F877A
	#INCLUDE <P16F877A.INC>
	SAYAC EQU 0X20
	ORG 0X000
	GOTO ANA_METOT
	ORG 0X004

KESME_METOT
	BTFSS INTCON,TMR0IF
	RETFIE
	BCF INTCON,TMR0IF

	MOVLW H'6'
	MOVWF TMR0

	DECFSZ SAYAC,F
	RETFIE
	
	MOVLW D'125'
	MOVWF SAYAC

;	MOVLW B'00000001'
;	XORWF PORTB

	MOVF PORTB,W
	SUBLW D'9'
	BTFSC STATUS,Z
	CLRF PORTB
	INCF PORTB,F

RETFIE

ANA_METOT
	BANKSEL TRISB
	CLRF TRISB
	BANKSEL PORTB
	CLRF PORTB
;	BSF PORTB,0

	BANKSEL INTCON
	MOVLW B'11100000'
	MOVWF INTCON
	BANKSEL INTCON
	
	BANKSEL OPTION_REG
	MOVLW B'00000100'
	MOVWF OPTION_REG
	BANKSEL OPTION_REG

	BANKSEL TMR0
	MOVLW H'6'
	MOVWF TMR0
	CLRF SAYAC
	MOVLW D'125'
	MOVWF SAYAC
	BANKSEL TMR0

KONTROL
	GOTO KONTROL

END